## components/mqtt/Kconfig.projbuild
```kconfig
menu "MQTT"
    config BROKER_URL
        string "Url del broker"
        default "mqtt://broker.emqx.io"

        
        

endmenu
```

## components/wifi/Kconfig.projbuild
```kconfig
menu "Comunicación Wifi"

    menu "Estación Wifi"
        config STA_SSID
            string "SSID"
            default "Asterisk"
            help
                Nombre de la red del punto de acceso externo
    
        config STA_PASS
            string "Password" 
            default "Ytjda3toGe"
            help 
                Contraseña del punto de acceso externo
    endmenu

endmenu
```
